## drivers/clk/msm/Kconfig
```kconfig
config COMMON_CLK_MSM
	tristate "Support for MSM clock controllers"
	depends on OF
	depends on ARCH_QCOM
	select RATIONAL
	help
	  This support clock controller used by MSM devices which support
	  global, mmss and gpu clock controller.
	  Say Y if you want to support the clocks exposed by the MSM on
	  platforms such as msm8953 etc.

config MSM_CLK_CONTROLLER_V2
	bool "QTI clock driver"
	depends on COMMON_CLK_MSM
	---help---
	   Generate clock data structures from definitions found in
	   device tree.

config MSM8953_CPU_VOLTAGE_CONTROL
	bool "MSM8953 CPU voltage control (UV_mV_table)"
	depends on ARCH_MSM8953 && CPU_FREQ_MSM && REGULATOR_CPR4_APSS
	help
	  Adds /sys/devices/system/cpu/cpuN/cpufreq/UV_mV_table. Reading it
	  lists the CPR ceiling voltage of every CPU frequency, highest
	  first; writing the same number of space separated millivolt
	  values sets those ceilings. Values are clamped to 500-1140 mV and
	  rounded up to 5 mV. Each change is applied as a CPR voltage
	  margin adjustment: the floor, open-loop voltage and target
	  quotients move with the ceiling, so CPR closed loop keeps its range.

	  If unsure, say N.

source "drivers/clk/msm/mdss/Kconfig"
```
